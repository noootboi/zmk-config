## config/west.yml
```yaml
manifest:
  remotes:
    - name: zmkfirmware
      url-base: https://github.com/zmkfirmware
    - name: infused-kim
      url-base: https://github.com/infused-kim
    - name: petejohanson
      url-base: https://github.com/petejohanson
    - name: urob
      url-base: https://github.com/urob
    - name: badjeff
      url-base: https://github.com/badjeff

  projects:

    #
    # zmk fork
    # Uncomment only one of these...
    #

    # Standard, stable zmk repo without mouse PR.
    # Not compatible with the PS/2 mouse & TP driver module.
    - name: zmk
      remote: zmkfirmware
      revision: main
      import: app/west.yml

    # infused-kim's zmk fork with mouse PR, which might be a bit outdated, but
    # is known to be compatible with the PS/2 mouse & TP driver module.
    #- name: zmk
    #  remote: infused-kim
    #  revision: pr-testing/mouse_ps2_module_base
    #  import: app/west.yml

    # pete's zmk fork with the most up to date mouse PR, which is more
    # up-to-date, but may contain incompatibilities with the PS/2 mouse & TP
    # driver module.
    # - name: zmk
    #   remote: petejohanson
    #   revision: feat/pointers-move-scroll
    #   import: app/west.yml

    # urob's zmk fork with mouse PR & many extra features, but may be
    # incompatible with the PS/2 mouse & TP driver module.
    # - name: zmk
    #   remote: urob
    #   revision: main
    #   import: app/west.yml

    # infused-kim's zmk fork with mouse PR AND urob's improvements, which
    # might be out-dated, but is known to be compatible with PS/2 mouse & TP
    # driver module.
    # - name: zmk
    #   remote: infused-kim
    #   revision: pr-testing/mouse_ps2_module_base_urob
    #   import: app/west.yml

    #
    # Additional zmk modules
    #

    # Module for PS/2 mouse & TP driver
    - name: kb_zmk_ps2_mouse_trackpoint_driver
      remote: badjeff
      revision: main

    - name: zmk-helpers
      remote: urob
      revision: main

        # ZMK modules
    - name: zmk-adaptive-key
      path: modules/zmk/adaptive-key
    - name: zmk-auto-layer
      path: modules/zmk/auto-layer
    - name: zmk-leader-key
      path: modules/zmk/leader-key
    - name: zmk-tri-state
      path: modules/zmk/tri-state


    # Temporarily overload Zephyr until
    # https://github.com/zmkfirmware/zephyr/pull/40 is merged.
    - name: zephyr
      revision: v3.5.0+zmk-fixes
      clone-depth: 1
      import:
        # Only enable most commonly used boards. For less common hardware one
        # may need to enable additional modules.
        name-allowlist:
          - cmsis
          - hal_nordic
          - hal_rpi_pico
          - hal_stm32
          - lvgl
          - tinycrypt
  self:
    path: config
```
