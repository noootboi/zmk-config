/*
 * Copyright (c) 2020 The ZMK Contributors
 *
 * SPDX-License-Identifier: MIT
 */

#include <behaviors.dtsi>
#include <behaviors/num_word.dtsi> // Requires auto-layer module.
#include <dt-bindings/zmk/keys.h>

#include "zmk-helpers/helper.h"
#include "includes/yk_do52_key.h"                                     

#include <dt-bindings/zmk/bt.h>
#include <dt-bindings/zmk/ext_power.h>
#include <dt-bindings/zmk/outputs.h>
#include "zmk-helpers/unicode-chars/german.dtsi"



/*
 * Defines to enable/disable features
 *
 * These defines allow us to conditionally enable and disable parts of the keymap config.
 *
 * For example, if we decide to build the firmware without the mouse features, we can
 * disable all the config options that rely on those forks and modules without having
 * to edit the entire keymap file manually every time.
 */

#define HAS_MOUSE_KEYS
#define HAS_MOUSE_TP

#define DEF       0
#define GAME      1
#define QWERTY    2
#define NAV       3
#define NUM       4
#define SYMBOL    5
#define MEDIA     6
#define FUNCTION  7
#define CONFIG    8
#define MOUSE     9
#define SCROLL_TP 10

#ifdef HAS_MOUSE_KEYS
  #include <dt-bindings/zmk/mouse.h>
  #include <behaviors/mouse_keys.dtsi>
#endif  // HAS_MOUSE_KEYS

#ifdef HAS_MOUSE_TP
  // We store the trackpoint settings in a separate file
  // to make organization a litlte easier.
  #include "includes/mouse_tp.dtsi"
#endif  // HAS_MOUSE_TP

// key-position labels
#define KEYS_L LT0 LT1 LT2 LT3 LT4 LM0 LM1 LM2 LM3 LM4 LB0 LB1 LB2 LB3 LB4  // left-hand keys
#define KEYS_R RT0 RT1 RT2 RT3 RT4 RM0 RM1 RM2 RM3 RM4 RB0 RB1 RB2 RB3 RB4  // right-hand keys
#define THUMBS  LH3 LH2 LH1 LH0 RH0 RH1 RH2 RH3                      // thumb keys


// Adjust layer keys based on enabled features.
//
// This prevents build errors when we build the firmware
// without the mouse keys PR or the TP module.
#ifdef HAS_MOUSE_KEYS
  #define U_THUMB_INNER &mo MOUSE_KEYS
#else
  #define U_THUMB_INNER &none
#endif  // HAS_MOUSE_KEYS

#ifdef HAS_MOUSE_TP
  #define U_TOG_TP_SET &tog MOUSE_TP_SET
#else
  #define U_TOG_TP_SET &none
#endif  // HAS_MOUSE_TP


/* Global defaults */

#define QUICK_TAP_MS 175

&sk {
  release-after-ms = <900>;
  quick-release;
};

&sl { // Allow sticky mods to chord across sticky layers.
  ignore-modifiers;
};

&lt {
  flavor = "balanced";
  tapping-term-ms = <200>;
  quick-tap-ms = <QUICK_TAP_MS>;
};

/* Homerow mods */

#define MAKE_HRM(NAME, HOLD, TAP, TRIGGER_POS)                                 \
  ZMK_HOLD_TAP(NAME, bindings = <HOLD>, <TAP>; flavor = "tap-preferred";            \
               tapping-term-ms = <200>; quick-tap-ms = <QUICK_TAP_MS>;         \
               require-prior-idle-ms = <210>; hold-trigger-on-release;         \
               hold-trigger-key-positions = <TRIGGER_POS>;)

MAKE_HRM(hml, &kp, &kp, KEYS_R THUMBS) // Left-hand HRMs.
MAKE_HRM(hmr, &kp, &kp, KEYS_L THUMBS) // Right-hand HRMs.

// Hack: Make HRM combos tap-only (cf, ZMK issue #544).
#define ZMK_COMBO_8(NAME, TAP, POS, LAYERS, COMBO_MS, IDLE_MS, HOLD, SIDE)     \
  MAKE_HRM(hm_combo_##NAME, &kp, TAP, SIDE THUMBS)                             \
  ZMK_COMBO_6(NAME, &hm_combo_##NAME HOLD 0, POS, LAYERS, COMBO_MS, IDLE_MS)



/* Combos, leader key sequences, mouse emulation */

#include "includes/combos.dtsi" // Must be sourced after HRM-combo hack.


/* Magic-shift & auto-layers */

// Tap: repeat after alpha, else sticky-shift |
// Shift + tap/ double-tap: caps-word | Hold: shift.
#define MAGIC_SHIFT &magic_shift LSHFT 0
ZMK_HOLD_TAP(magic_shift, bindings = <&kp>, <&magic_shift_tap>;
             flavor = "balanced"; tapping-term-ms = <200>;
             quick-tap-ms = <QUICK_TAP_MS>;)
ZMK_MOD_MORPH(magic_shift_tap, bindings = <&shift_repeat>, <&caps_word>;
              mods = <(MOD_LSFT)>;)
ZMK_ADAPTIVE_KEY(
    shift_repeat, bindings = <&sk LSHFT>;
    repeat {
      trigger-keys = <A B C D E F G H I J K L M N O P Q R S T U V W X Y Z>;
      bindings = <&key_repeat>;
      max-prior-idle-ms = <1200>;
      strict-modifiers;
    };)
&caps_word { // Mods deactivate caps-word, requires PR #1451. [TODO: rebase]
  /delete-property/ ignore-modifiers;
};



// Tap: num-word | double-tap: sticky num-layer | Hold: num-layer.
#define SMART_NUM &smart_num NUM 0
ZMK_HOLD_TAP(smart_num, bindings = <&mo>, <&num_dance>; flavor = "balanced";
             tapping-term-ms = <200>; quick-tap-ms = <QUICK_TAP_MS>;)
ZMK_TAP_DANCE(num_dance, bindings = <&num_word NUM>, <&sl NUM>;
              tapping-term-ms = <200>;)


// Define mod-morph with a *single* mod trigger for less repetition.
#define SIMPLE_MORPH(NAME, MOD, BINDING1, BINDING2)                            \
  ZMK_MOD_MORPH(NAME, mods = <(MOD_L##MOD | MOD_R##MOD)>;                      \
                bindings = <BINDING1>, <BINDING2>;)


// Tap: qmark | Shift + tap: excl.
SIMPLE_MORPH(qexcl, SFT, &kp QMARK, &kp EXCL)

// Tap: left/right parenthesis | Shft + tap: less-than/greater-than.
SIMPLE_MORPH(lpar_lt, SFT, &kp LPAR, &kp LT)
SIMPLE_MORPH(rpar_gt, SFT, &kp RPAR, &kp GT)


// Tap: backspace | Lshft + tap: delete | Rshft + tap: shift-delete.
ZMK_MOD_MORPH(bs_del, bindings = <&kp BSPC>, <&kp DEL>;
              mods = <(MOD_LSFT|MOD_RSFT)>; keep-mods = <MOD_RSFT>;)

// Tap: copy | double-tap: cut.
ZMK_TAP_DANCE(copy_cut, bindings = <&kp LC(INS)>, <&kp LC(X)>;
              tapping-term-ms = <200>;)


// Disable line-wrap in your editor to see a "visualization" of the key layouts
/ {

combos {
        compatible = "zmk,combos";
        combo_esc {
            timeout-ms = <COMBO_TERM_SLOW>;
            require-prior-idle-ms = <COMBO_IDLE_SLOW>;
            key-positions = <32 44>;
            bindings = <&kp FSLH>;
        };

        combo_star {
        timeout-ms = <COMBO_TERM_SLOW>;
        require-prior-idle-ms = <COMBO_IDLE_SLOW>;
        key-positions = <20 32>;
        bindings = <&kp N8>;
    };    


};
  
  //0
  keymap {
    compatible = "zmk,keymap";
   
    Base_layer {
      display-name = "Base";
      bindings = <
//|-----------------|------------------|----------------|----------------|-----------------|----------------|                   |----------------|----------------|----------------|----------------|----------------|----------------|
  &kp ESCAPE         &kp N1             &kp N2           &kp N3           &kp N4            &kp N5                               &kp N6           &kp N7           &kp N8           &kp N9           &kp N0           &kp DELETE
  &kp TAB            &kp B              &kp Y            &kp O            &kp U             &qexcl                               &kp X            &kp L            &kp D            &kp P            &kp F            &kp Z 
  &kp CAPSLOCK       &hml LGUI C        &hml LALT I      &hml LSHIFT E    &hml LCTRL A      &kp COMMA                            &kp K            &hmr LCTRL H     &hmr RSHIFT T    &hmr LALT N      &hmr LGUI S      &kp Q
  &kp LSHFT          &kp SEMI           &kp EQUAL        &kp SQT          &kp DOT           &kp MINUS                            &kp J            &kp M            &kp G            &kp W            &kp V            SMART_NUM
  &lt 4 TAB          &kp LEFT_ALT                                         MAGIC_SHIFT       &kp SPACE                           &kp R          &kp BACKSPACE                                      &lt SYMBOL RIGHT_ALT  &kp ENTER

                                             // DPAD  Left,     Down,      Middle,            Up,               Right
                                                      &kp LEFT  &kp DOWN   &kp PSCRN          &kp UP            &kp RIGHT
                                                      &kp HOME  SMART_NUM  &to  1            &lt CONFIG PG_UP  &kp END
      >;
    };
//1
      Game_layer {
      display-name = "Game";
      bindings = <
//|-----------------|-------------|-----------|------------|-----------------|----------------|--------------|   |---------------|---------------|-------------|-----------|-------------|---------------|------------|
   &kp ESC           &kp N1        &kp N2      &kp N3       &kp N4            &kp N5                                              &kp N6          &kp N7        &kp N8       &kp N9          &kp N0          &kp MINUS
   &kp TAB           &kp Q         &kp W       &kp E        &kp R             &kp T                                               &kp Y           &kp U         &kp I        &kp O           &kp P           &kp EQUAL
   &kp RBKT          &kp A         &kp S       &kp D        &kp F             &kp G                                               &kp H           &kp J         &kp K        &kp L           &kp SEMI        &kp SQT
   &kp LSHFT         &kp Z         &kp X       &kp C        &kp V             &kp B                                               &kp N           &kp M         &kp COMMA    &kp DOT         &kp FSLH        &kp BSLH
   &kp LCTRL         &kp LMETA                              &kp SPACE         &lt MEDIA TAB                                       &mkp DEL        &mkp RET                                   &kp LALT        &kp RALT
                                             // DPAD  Left,     Down,      Middle,     Up,        ,Right
                                                      &kp LEFT  &kp DOWN   &kp PSCRN   &kp UP     &kp RIGHT
                                                      &kp HOME  &kp PG_DN  &to 0       &kp PG_UP  &kp END
      >;
    };
//2
      Qwerty_layer {
      display-name = "Qwerty";
      bindings = <
//|-----------------|-------------|-----------|------------|-----------------|----------------|--------------|   |---------------|---------------|-------------|-----------|-------------|---------------|------------|
   &kp GRAVE         &kp N1        &kp N2      &kp N3       &kp N4            &kp N5                                               &kp N6          &kp N7        &kp N8       &kp N9          &kp N0          &kp MINUS
   &kp LBKT          &kp Q         &hml RALT W &kp E        &kp R             &kp T                                                &kp Y           &kp U         &kp I        &lt SCROLL_TP O &lt MOUSE P     &lt SCROLL_TP EQUAL
   &kp RBKT          &hml LMETA A  &hml LALT S &hml LCTRL D &hml LSHIFT F     &kp G                                                &kp H           &hml LSHIFT J &hmr LCTRL K &hmr LALT L     &hmr LMETA SEMI &lt SCROLL_TP SQT
   &kp LSHFT         &kp Z         &hml RALT X &kp C        &kp V             &kp B                                                &kp N           &kp M         &kp COMMA    &hmr RALT DOT   &lt MOUSE FSLH  &lt SCROLL_TP BSLH
   &kp LCTRL         &kp LMETA                              &lt FUNCTION ESC  &lt NAV   TAB                                        &lt MEDIA DEL   &kp M                                      &kp LALT        &kp RALT
                                             // DPAD  Left,     Down,      Middle,     Up,        Right
                                                      &kp LEFT  &kp DOWN   &kp PSCRN   &kp UP     &kp RIGHT
                                                      &kp HOME  &kp PG_DN  &to 0       &kp PG_UP  &kp END
      >;
    };
//3
    Nav_layer {
      display-name = "Nav";
         bindings = <
//|------------|-------------|-----------|-----------|---------------|---------------|---------------|   |---------------|---------------|-------------|-----------|-------------|---------------|------------|
   &trans       &trans         &trans       &trans       &trans           &trans                                               &trans          &trans        &trans      &trans        &trans          &trans
   &trans       &kp HOME      &kp PG_UP   &kp PG_DN   &kp END         &trans                                               &trans          &kp RA(GRAVE) &kp RA(SQT) &trans        &trans          &trans
   &trans       &kp LEFT      &kp UP      &kp DOWN    &kp RIGHT       &caps_word                                          &trans          &kp LSHIFT    &kp LCTRL   &kp LALT      &kp LMETA       &trans
   &trans       &trans         &trans       &trans       &trans           &trans                                               &trans          &trans        &trans      &kp RALT      &trans          &trans
   &trans       &trans                                &caps_word      &kp LBKT                                             &trans          &trans                                  &trans          &trans 
                                        // DPAD Left,      Down,   Middle,     Up,     Right
                                                &trans     &trans  &trans      &trans  &trans  
                                                &trans     &trans  &to 0       &trans  &trans 
      >;
    };



//4
    Num_layer {
      display-name = "Number";
        bindings = <
//|------------|-------------|-----------|-----------|---------------|---------------|---------------|   |---------------|---------------|-------------|-------------|-------------|---------------|------------|
   &kp F12      &kp F1        &kp F2      &kp F3      &kp F4          &kp F5                                              &kp F6          &kp F7        &kp F8        &kp F9        &kp F10         &kp F11         
   &trans        &trans         &trans       &trans       &trans           &trans                                               &trans         &kp NUMBER_7  &kp NUMBER_8  &kp NUMBER_9  &kp EQUAL       &trans
   &trans        &trans         &trans       &trans       &trans           &trans                                               &trans         &kp NUMBER_4  &kp NUMBER_5  &kp NUMBER_6  &kp DOT         &trans
   &trans        &trans         &trans       &trans       &trans           &trans                                               &trans         &kp NUMBER_1  &kp NUMBER_2  &kp NUMBER_3  &kp ASTERISK    &trans
   &trans        &trans                                 &trans           &trans                                                 &kp BACKSPACE   &kp NUMBER_0                              &trans           &trans 
                                        // DPAD Left,      Down,   Middle,     Up,     Right
                                                &trans      &trans   &trans       &trans   &trans  
                                                &trans      &trans   &to 0        &trans   &trans 
      >;
    };

  //5
    Symb_layer {
      display-name = "Symbol";
          bindings = <
//|--------------|-------------|-----------|-----------|---------------|---------------|---------------|   |---------------|---------------|-------------|-----------|-------------|---------------|------------|
   &studio_unlock  &trans        &trans      &trans      &trans          &trans                                              &bt BT_SEL 0    &bt BT_SEL 1  &bt BT_SEL 2  &bt BT_SEL 3  &bt BT_SEL 4    &trans
   &trans          &trans        &trans      &trans      &trans          &trans                                              &bt BT_CLR      &bt BT_PRV    &out OUT_USB  &out OUT_BLE  &bt BT_NXT      &trans
   &sys_reset      &trans        &trans      &trans      &trans          &trans                                              &bt BT_CLR_ALL  &out OUT_TOG  &trans        &trans        &trans          &sys_reset
   &bootloader     &trans        &trans      &trans      &trans          &trans                                              &bt BT_DISC 0   &bt BT_DISC 1 &bt BT_DISC 2 &bt BT_DISC 3 &bt BT_DISC 4   &bootloader
   &trans          &trans                                &trans          &trans                                              &trans          &trans                                    &trans          &trans 
                                        // DPAD Left,      Down,   Middle,     Up,     Right
                                                &trans     &trans  &trans      &trans  &trans  
                                                &trans     &trans  &to 0       &trans  &trans 

      >;
    };
 //6
  Media_layer {
      display-name = "Media";
         bindings = <
//|--------------|-------------|-------------|-------------|---------------|---------------|---------------|   |---------------|---------------|-------------|-----------|-------------|---------------|------------|
   &studio_unlock &trans        &trans        &trans        &trans          &trans                                              &trans          &trans        &trans      &trans        &trans          &trans
   &trans         &kp C_BRI_DEC &kp C_VOL_DN  &kp C_VOL_UP  &kp C_BRI_INC   &trans                                              &kp KMLT        &kp KP_N7     &kp KP_N8   &kp KP_N9     &kp KMIN        &trans
   &tog QWERTY    &kp C_BRI_DEC &kp C_VOL_DN  &kp C_VOL_UP  &kp C_BRI_INC   &trans                                              &kp KDIV        &kp KP_N4     &kp KP_N5   &kp KP_N6     &kp KPLS        &trans
   &tog GAME      &trans        &trans        &trans        &trans          &trans                                              &kp KP_N0       &kp KP_N1     &kp KP_N2   &kp KP_N3     &kp KP_DOT      &trans
   &to DEF        &trans                                    &kp HASH        &kp LBRC                                            &trans          &trans                                  &trans          &trans
                                        // DPAD Left,      Down,   Middle,     Up,     Right
                                                &trans     &trans  &trans      &trans  &trans  
                                                &trans     &trans  &to 0       &trans  &trans 
      >;
    };

    
//7
    Func_layer {
      display-name = "Function";
      bindings = <
//|-----------------|-------------|-----------|-----------|---------------|---------------|---------------|   |---------------|---------------|-------------|-----------|-------------|---------------|------------|
   &studio_unlock    &trans        &trans      &trans      &trans          &trans                                              &trans          &trans        &trans      &trans        &trans          &trans
   &trans            &trans        &trans      &trans      &trans          &trans                                              &trans          &kp F7        &kp F8      &kp F9        &kp F10         &trans
   &trans            &trans        &trans      &trans      &trans          &trans                                              &trans          &kp F4        &kp F5      &kp F6        &kp F11         &trans
   &bootloader       &trans        &trans      &trans      &trans          &trans                                              &trans          &kp F1        &kp F2      &kp F3        &kp F12         &trans
   &trans            &trans                                &trans          &trans                                              &trans          &trans                                  &trans          &trans 
                                        // DPAD Left,      Down,   Middle,     Up,     Right
                                                &trans     &trans  &trans      &trans  &trans 
                                                &trans     &trans  &to 0       &trans  &trans
      >;
    };
//8
    Config_layer {
      display-name = "Configuration";
      bindings = <
//|---------------|-------------|-----------|-----------|---------------|---------------|---------------|   |---------------|---------------|-------------|-------------|-------------|---------------|------------|
   &studio_unlock &kp F1        &kp F2      &kp F3      &kp F4          &kp F5                                              &kp F6          &kp F7        &kp F8        &kp F9        &kp F10         &kp F11
   &trans         &trans        &kp RALT    &trans      &trans          &trans                                              &kp TILDE       &kp AMPERSAND &kp STAR      &kp LPAR      &kp PLUS        &kp F12
   &tog QWERTY    &kp LMETA     &kp LALT    &kp LCTRL   &kp LSHIFT      &trans                                              &kp LBRC        &kp DOLLAR    &kp PERCENT   &kp CARET     &kp DQT         &trans
   &tog GAME      &trans        &kp RALT    &trans      &trans          &trans                                              &kp RBRC        &kp EXCL      &kp AT        &kp HASH      &kp PIPE        &trans
   &to DEF        &trans                                &mo 8           &trans                                              &kp RPAR        &kp UNDER                                 &trans          &trans 
                                          // DPAD Left,      Down,   Middle,     Up,     Right
                                                &trans     &trans  &trans      &trans  &trans  
                                                &trans     &trans  &to 0       &trans  &trans
      >;
    };

   //9
     Mouse_layerAuto {
      display-name = "Mouse_Auto";
      bindings = <
//|------------|-------------|-----------|-----------|---------------|---------------|---------------|   |---------------|---------------|-------------|-----------|---------------|---------------|------------|
   &trans       &trans        &trans      &trans      &trans          &trans                                              &trans          &trans        &trans      &trans          &trans          &trans
   &trans       &trans        &trans      &trans      &trans          &trans                                              &trans          &trans        &trans      &mo SCROLL_TP   &none           &mo SCROLL_TP
   &trans       &trans        &trans      &trans      &trans          &trans                                              &trans          &trans        &trans      &trans          &trans          &mo SCROLL_TP
   &trans       &trans        &trans      &trans      &trans          &trans                                              &trans          &trans        &trans      &mo SCROLL_TP   &none           &mo SCROLL_TP
   &trans       &trans                                &trans          &trans                                              &mkp MCLK       &mkp RCLK                                 &trans          &trans 
                                           // DPAD Left,      Down,   Middle,     Up,     Right
                                                   &trans     &trans  &trans      &trans  &trans
                                                   &trans     &trans  &to 0       &trans  &trans
         >;
       };

//10'
     Scroll_layer {
      display-name = "Scroll";
      bindings = <
//|-------------|-------------|-----------|-----------|---------------|---------------|---------------|   |---------------|---------------|-------------|-----------|-------------|---------------|------------|
   &trans        &trans        &trans      &trans      &trans          &trans                                              &trans          &trans        &trans      &trans        &trans          &trans
   U_MSS_TP_S_I  &trans        &trans      &trans      &trans          &trans                                              &trans          &trans        &trans      &none         &mo MOUSE       &trans
   U_MSS_TP_S_D  &trans        &trans      &trans      &trans          &trans                                              &trans          &trans        &trans      &trans        &trans          &trans
   &trans        &trans        &trans      &trans      &trans          &trans                                              &trans          &trans        &trans      &trans        &trans          &trans
   &trans        &trans                                &trans          &trans                                              &mkp MCLK       &mkp RCLK                               &trans          &trans 
                                        // DPAD Left,      Down,   Middle,     Up,     Right
                                                &trans     &trans  &trans      &trans  &trans  
                                                &trans     &trans  &to 0       &trans  &trans           
      >;
    };




#ifdef HAS_MOUSE_KEYS

#endif
#ifdef HAS_MOUSE_TP
//         // You can find the defines for the actual key press behaviors in `include/mouse_tp.dtsi`.
//         MouseSettings_layer {
//           display-name = "TP Set";
//           bindings = <
//     // ╭────────────────────────┬────────────────────────┬────────────────────────┬────────────────────────┬────────────────────────┬────────────────────────╮    ╭────────────────────────┬────────────────────────┬────────────────────────┬────────────────────────┬────────────────────────┬────────────────────────╮
//          U_TOG_TP_SET             U_TOG_TP_SET             &none                    U_MSS_TP_S_D             U_MSS_TP_S_I             U_MSS_TP_PT_I                 U_MSS_TP_PT_I            U_MSS_TP_S_D             U_MSS_TP_S_I             &none                    U_TOG_TP_SET              U_TOG_TP_SET
//     // ├────────────────────────┼────────────────────────┼────────────────────────┼────────────────────────┼────────────────────────┼────────────────────────┤    ├────────────────────────┼────────────────────────┼────────────────────────┼────────────────────────┼────────────────────────┼────────────────────────┤
//          U_MSS_RESET              U_MSS_RESET              &none                    U_MSS_TP_NI_D            U_MSS_TP_NI_I            U_MSS_TP_PT_D                 U_MSS_TP_PT_D            U_MSS_TP_NI_D            U_MSS_TP_NI_I            &none                    U_MSS_RESET               U_MSS_RESET
//     // ├────────────────────────┼────────────────────────┼────────────────────────┼────────────────────────┼────────────────────────┼────────────────────────┤    ├────────────────────────┼────────────────────────┼────────────────────────┼────────────────────────┼────────────────────────┼────────────────────────┤
//          U_MSS_LOG                U_MSS_LOG                &none                    U_MSS_TP_V6_D            U_MSS_TP_V6_I            &none                         &none                    U_MSS_TP_V6_D            U_MSS_TP_V6_I            &none                    U_MSS_LOG                 U_MSS_LOG
//     // ╰────────────────────────┴────────────────────────┴────────────────────────┴────────────────────────┼────────────────────────┼────────────────────────┤    ├────────────────────────┼────────────────────────┼────────────────────────┼────────────────────────┴────────────────────────┼────────────────────────╯
//                                                                                     &trans                   &mkp LCLK                &mkp RCLK                     &none                    &mkp LCLK                &mkp RCLK
//     //                                                                            ╰────────────────────────┴────────────────────────┴────────────────────────╯    ╰────────────────────────┴────────────────────────┴────────────────────────╯
//           >;
//         };


#endif

 

  };
};